## CMakeLists.txt
```
# SPDX-License-Identifier: Apache-2.0

cmake_minimum_required(VERSION 3.20.0)

find_package(Zephyr REQUIRED HINTS $ENV{ZEPHYR_BASE})
project(peripheral_hr)

FILE(GLOB app_sources src/*.c)
target_sources(app PRIVATE
  ${app_sources}
  )
target_include_directories(app PRIVATE inc)

zephyr_library_include_directories($${CMAKE_CURRENT_SOURCE_DIR}/inc)
```

## Kconfig
```
config CACHE_SIZE
	int "Max number of samples that can be stored in the cache"
    range 1 100
    default 50

config SAMPLE_INTERVAL_SEC
	int "Sensor Sampling interval"
    range 1 3600
    default 4

config TRANSMIT_INTERVAL_SEC
	int "Data notification interval"
    range 1 3600
    default 2

source "Kconfig.zephyr"
```

## prj.conf
```kconfig
CONFIG_LOG=y

# Basic BLE configs
CONFIG_BT=y
CONFIG_BT_SMP=y
CONFIG_BT_PERIPHERAL=y
CONFIG_BT_DEVICE_NAME="Vynnychek Test App"
CONFIG_BT_GATT_CLIENT=y

# increase MTU
CONFIG_BT_L2CAP_TX_MTU=110
CONFIG_BT_BUF_ACL_RX_SIZE=114
CONFIG_BT_BUF_ACL_TX_SIZE=114
```

## src/main.c
```c
#include <zephyr/kernel.h>
#include <zephyr/logging/log.h>
#include <zephyr/bluetooth/bluetooth.h>
#include <zephyr/bluetooth/gatt.h>
#include <zephyr/bluetooth/hci.h>
#include <zephyr/bluetooth/uuid.h>

#include "mem_cache.h"

LOG_MODULE_REGISTER(main, LOG_LEVEL_INF);


/******************************************************************************
 * Data Types
 ******************************************************************************/

/* Device connection states for the main loop state machine */
enum {
    STATE_DISCONNECTED,
    STATE_CONNECTED,
    STATE_MAX,
};

typedef struct {
	struct bt_conn *current_conn;  	/* Active BLE connection handle */
	struct k_timer tx_timer;	   	/* Periodic transmit timer */
	bool notify_enabled;			/* Notification enable flag */
	atomic_t state;					/* Atomic application state bitmap */
} app_data_t;


/******************************************************************************
 * Macro
 ******************************************************************************/

/* Custom 128-bit UUID for the Sensor Service */
#define BT_UUID_SENSOR_SERVICE \
    BT_UUID_DECLARE_128(BT_UUID_128_ENCODE(0xf0debc9a, 0x7856, 0x3412, 0x7856, 0x341278563412))

/* Custom 128-bit UUID for the Sensor Data Characteristic (Notify) */
#define BT_UUID_SENSOR_DATA \
    BT_UUID_DECLARE_128(BT_UUID_128_ENCODE(0xf1debc9a, 0x7856, 0x3412, 0x7856, 0x341278563412))

/* Custom 128-bit UUID for the Sample Count Characteristic (Read) */
#define BT_UUID_SAMPLE_COUNT \
    BT_UUID_DECLARE_128(BT_UUID_128_ENCODE(0xf2debc9a, 0x7856, 0x3412, 0x7856, 0x341278563412))


/******************************************************************************
 * Static Variables
 ******************************************************************************/

/* Application data */
static app_data_t app_data;

/* Advertising data packets */
static const struct bt_data ad[] = {
    BT_DATA_BYTES(BT_DATA_FLAGS, (BT_LE_AD_GENERAL | BT_LE_AD_NO_BREDR)),
    BT_DATA(BT_DATA_NAME_COMPLETE, CONFIG_BT_DEVICE_NAME, sizeof(CONFIG_BT_DEVICE_NAME) - 1),
};

/* Scan response data packets */
static const struct bt_data sd[] = {
    BT_DATA(BT_DATA_NAME_COMPLETE, CONFIG_BT_DEVICE_NAME, sizeof(CONFIG_BT_DEVICE_NAME) - 1),
};


/******************************************************************************
 * GATT Callbacks
 ******************************************************************************/

/**
 * @brief Read callback for the Sample Count characteristic.
 * 
 * @param conn   The connection object.
 * @param attr   The attribute being read.
 * @param buf    Buffer to store the read data.
 * @param len    Length of the buffer.
 * @param offset Read offset.
 * @return Number of bytes read or GATT error code.
 */
static ssize_t read_sample_count(struct bt_conn *conn, const struct bt_gatt_attr *attr,
                                 void *buf, uint16_t len, uint16_t offset)
{
    uint32_t count = mem_cache_count();
    return bt_gatt_attr_read(conn, attr, buf, len, offset, &count, sizeof(count));
}

/**
 * @brief Client Configuration Characteristic (CCC) change callback.
 * 
 * @param attr  The CCC attribute.
 * @param value The configuration value (Notify vs Disabled).
 */
static void ccc_cfg_changed(const struct bt_gatt_attr *attr, uint16_t value)
{
    app_data.notify_enabled = (value == BT_GATT_CCC_NOTIFY);
    LOG_INF("Notifications %s", app_data.notify_enabled ? "enabled" : "disabled");
}

/* GATT Service Definition */
BT_GATT_SERVICE_DEFINE(sensor_svc,
    BT_GATT_PRIMARY_SERVICE(BT_UUID_SENSOR_SERVICE),

    BT_GATT_CHARACTERISTIC(BT_UUID_SENSOR_DATA,
                           BT_GATT_CHRC_NOTIFY,
                           BT_GATT_PERM_NONE,
                           NULL, NULL, NULL),

    BT_GATT_CCC(ccc_cfg_changed, BT_GATT_PERM_READ | BT_GATT_PERM_WRITE),

    BT_GATT_CHARACTERISTIC(BT_UUID_SAMPLE_COUNT,
                           BT_GATT_CHRC_READ,
                           BT_GATT_PERM_READ,
                           read_sample_count, NULL, NULL),
);


/******************************************************************************
 * TX and MTU exchange handling
 ******************************************************************************/

/**
 * @brief Periodic timer handler for transmitting sensor data.
 * 
 * Pops a sample from the memory cache and sends a GATT notification 
 * if a connection is active and notifications are enabled.
 * 
 * @param timer Pointer to the kernel timer.
 */
static void tx_timer_handler(struct k_timer *timer)
{
    if (!app_data.current_conn || !app_data.notify_enabled) {
        return;
    }

    sensor_sample_t sample;
    if (!mem_cache_pop(&sample)) {
        return;
    }

    /* Attributes index 1 points to the SENSOR_DATA characteristic */
    int err = bt_gatt_notify(app_data.current_conn, &sensor_svc.attrs[1], &sample, sizeof(sample));
    if (err) {
        LOG_WRN("Notify failed (err %d), re-pushing sample to cache", err);
        mem_cache_push(&sample);
    }
}

/**
 * @brief Callback for GATT MTU exchange completion.
 * 
 * @param conn   The connection object.
 * @param err    Error status of the exchange (0 for success).
 * @param params Exchange parameters.
 */
static void mtu_exchange_cb(struct bt_conn *conn, uint8_t err, struct bt_gatt_exchange_params *params)
{
    LOG_INF("MTU exchange %s, current MTU: %u", 
            err == 0U ? "successful" : "failed", 
            bt_gatt_get_mtu(conn));
}

/* MTU exchange data */
static struct bt_gatt_exchange_params mtu_exchange_params = {
    .func = mtu_exchange_cb
};


/******************************************************************************
 * Connection Callbacks
 ******************************************************************************/

/**
 * @brief Connection established callback.
 * 
 * @param conn The connection object.
 * @param err  HCI error code (0 for success).
 */
static void connected(struct bt_conn *conn, uint8_t err)
{
    if (err) {
        LOG_ERR("Connection failed (err 0x%02x)", err);
    } else {
        app_data.current_conn = bt_conn_ref(conn);
        atomic_set_bit(&app_data.state, STATE_CONNECTED);
        
        /* Initiate MTU exchange to optimize packet size */
        bt_gatt_exchange_mtu(conn, &mtu_exchange_params);
        LOG_INF("Connected");
    }
}

/**
 * @brief Connection disconnected callback.
 * 
 * @param conn   The connection object.
 * @param reason HCI disconnect reason code.
 */
static void disconnected(struct bt_conn *conn, uint8_t reason)
{
    if (app_data.current_conn) {
        bt_conn_unref(app_data.current_conn);
        app_data.current_conn = NULL;
    }
    atomic_set_bit(&app_data.state, STATE_DISCONNECTED);
    LOG_INF("Disconnected (reason 0x%02x)", reason);
}

BT_CONN_CB_DEFINE(conn_callbacks) = {
    .connected = connected,
    .disconnected = disconnected,
};


/******************************************************************************
 * Initialization
 ******************************************************************************/

/**
 * @brief Initializes the BLE service timer and intervals.
 */
void ble_service_init(void)
{
    k_timer_init(&app_data.tx_timer, tx_timer_handler, NULL);
    k_timer_start(&app_data.tx_timer, 
                  K_SECONDS(CONFIG_TRANSMIT_INTERVAL_SEC), 
                  K_SECONDS(CONFIG_TRANSMIT_INTERVAL_SEC));

    LOG_INF("BLE service initialized");
}

/**
 * @brief Application entry point.
 * 
 * Initializes Bluetooth, starts the advertising state machine, 
 * and maintains the main application loop.
 */
int main(void)
{
	int err;
    LOG_INF("Starting BLE Sensor Application");

    ble_service_init();
    err = bt_enable(NULL);
    if (err) {
        LOG_ERR("Bluetooth enable failed (err %d)", err);
        return 0;
    }

    atomic_set_bit(&app_data.state, STATE_DISCONNECTED);

    while (1) {
        k_sleep(K_SECONDS(1));

        if (atomic_test_and_clear_bit(&app_data.state, STATE_CONNECTED)) {
            /* Connected handler */
        } 
        else if (atomic_test_and_clear_bit(&app_data.state, STATE_DISCONNECTED)) {
            /* Disconnected handler */
            LOG_INF("Starting Advertising...");
            err = bt_le_adv_start(BT_LE_ADV_CONN_FAST_1, ad, ARRAY_SIZE(ad), sd, ARRAY_SIZE(sd));
            if (err) {
                LOG_ERR("Advertising failed to start (err %d)", err);
                return 0;
            }
        }
    }
}
```

## inc/mem_cache.h
```c
#pragma once
#include <stdbool.h>
#include <stddef.h>

#define IMU_SAMPLE_LEN 20
#define TEMP_SAMPLE_LEN 3


// REVIEW: why is the __attribute__((packed)) here? what are the benefits of doing that?
typedef struct __attribute__((packed)) {
    uint32_t imu[IMU_SAMPLE_LEN];
    double temp[TEMP_SAMPLE_LEN];
} sensor_sample_t;

/**
 * @brief Push a sample into the FIFO cache.
 *
 * @param sample Pointer to the sensor sample to be added to the cache.
 * @return true if the sample was added successfully, false if the cache is full.
 */
bool mem_cache_push(const sensor_sample_t *sample);

/**
 * @brief Pop the oldest sample from the cache.
 *
 * @param out Pointer to where the oldest sample will be stored.
 * @return true if a sample was popped successfully, false if the cache is empty.
 */
bool mem_cache_pop(sensor_sample_t *out);

/**
 * @brief Get the current count of samples in the cache.
 *
 * @return The number of samples currently stored in the cache.
 */
size_t mem_cache_count(void);
```

## src/mem_cache.c
```c
#include <zephyr/kernel.h>
#include <zephyr/init.h>
#include <string.h>
#include "mem_cache.h"

/* Define a structure to hold the cache and its metadata. */
struct mem_cache_t {
    sensor_sample_t data[CONFIG_CACHE_SIZE];   /* Array to store sensor samples */
    size_t write_idx;                          /* Index of the next head position */
    size_t read_idx;                           /* Index of the next tail position */
    size_t count;                              /* Current count of samples in the cache */
    struct k_mutex lock;                       /* Mutex for thread safety */
};

/* Create the module instance. */
static struct mem_cache_t cache;

/**
 * @brief Push a sample into the FIFO cache.
 *
 * @param sample Pointer to the sensor sample to be added to the cache.
 * @return true if the sample was added successfully, false if the cache is full.
 */
bool mem_cache_push(const sensor_sample_t *sample) 
{
    k_mutex_lock(&cache.lock, K_FOREVER);

    if (cache.count == CONFIG_CACHE_SIZE) {
        k_mutex_unlock(&cache.lock);
        return false;
    }

    memcpy(&cache.data[cache.write_idx], sample, sizeof(sensor_sample_t));
    cache.write_idx = (cache.write_idx + 1) % CONFIG_CACHE_SIZE;
    cache.count++;

    k_mutex_unlock(&cache.lock);
    return true;
}

/**
 * @brief Pop the oldest sample from the cache.
 *
 * @param out Pointer to where the oldest sample will be stored.
 * @return true if a sample was popped successfully, false if the cache is empty.
 */
bool mem_cache_pop(sensor_sample_t *out)
{
    k_mutex_lock(&cache.lock, K_FOREVER);

    if (cache.count == 0) {
        k_mutex_unlock(&cache.lock);
        return false;
    }

    memcpy(out, &cache.data[cache.read_idx], sizeof(sensor_sample_t));
    cache.read_idx = (cache.read_idx + 1) % CONFIG_CACHE_SIZE;
    cache.count--;

    k_mutex_unlock(&cache.lock);
    return true;
}

/**
 * @brief Get the current count of samples in the cache.
 *
 * @return The number of samples currently stored in the cache.
 */
size_t mem_cache_count(void)
{
    k_mutex_lock(&cache.lock, K_FOREVER);
    size_t c = cache.count;
    k_mutex_unlock(&cache.lock);
    return c;
}

/**
 * @brief Initialize the memory cache.
 *
 * This function initializes the mutex and resets the head, tail, and count
 * to zero, preparing the memory cache for use.
 */
static int mem_cache_init(void)
{
    cache.count = 0;
    cache.read_idx = 0;
    cache.write_idx = 0;
    k_mutex_init(&cache.lock);

    return 0;
}

SYS_INIT(mem_cache_init, POST_KERNEL, CONFIG_KERNEL_INIT_PRIORITY_DEVICE);
```

## src/sensor_mock.c
```c
#include <zephyr/kernel.h>
#include <zephyr/random/random.h>
#include <zephyr/logging/log.h>
#include <zephyr/init.h>
#include <math.h>
#include "mem_cache.h"
#include <stdlib.h>

LOG_MODULE_REGISTER(sensor_mock, LOG_LEVEL_INF);


#define UINT16_TO_DOUBLE_SCALABLE 0

#if UINT16_TO_DOUBLE_SCALABLE
#define TEMP_MIN  (-60)
#define TEMP_MAX  (120)
#endif /* UINT16_TO_DOUBLE_SCALABLE */


static struct k_timer sample_timer;

/**
 * @brief Convert 16-bit unsigned value to double-precision value.
 * @param u16 Raw 16-bit raw value.
 * @return Converted value as double-precision floating point.
 */
static double uint16_to_double(uint16_t u16)
{
#if UINT16_TO_DOUBLE_SCALABLE
    double normalized = (double)u16 / 65535.0;
    return TEMP_MIN + (normalized * (TEMP_MAX - TEMP_MIN));
#else
/*
double 16 bit:
     S | EEEEE | MMMMMMMMMM
    15 | 14 10 | 9        0
 
double 64 bit:
     S | EEEEEEEEEEE | MMMMMMMMMMMMMMMMMMMMMMMMMMMMMMMMMMMMMMMMMMMMMMMMMMMM
    63 | 62       52 | 51                                                 0
*/
    uint16_t sign = (u16 >> 15) & 0x1;  /* Bit 15: sign (0 = positive, 1 = negative) */
    uint16_t exp  = (u16 >> 10) & 0x1F; /* Bits 10–14: exponent (5 bits) */
    uint16_t mant = u16 & 0x03FF;       /* Bits 0–9: mantissa (10 bits) */

    /* Case 1: subnormal numbers (exponent == 0) */
    if (exp == 0) {
        /* Value = fraction × 2^(-24) */
        double value = ldexp((double)mant, -24);
        return sign ? -value : value;
    }

    /* Case 2: infinity or NaN (exponent == 31) */
    if (exp == 31) {
        return mant ? NAN : (sign ? -INFINITY : INFINITY);
    }

    /* Case 3: normalized numbers */
    /* Value = (1 + fraction/1024) × 2^(exp − 15) */
    double value = ldexp(1.0 + (mant / 1024.0), exp - 15);
    return sign ? -value : value;
#endif /* UINT16_TO_DOUBLE_SCALABLE */
}

/**
 * @brief Timer callback for generating mock sensor samples.
 *
 * This handler is called periodically by a Zephyr kernel timer.
 * It generates mock IMU and temperature samples and pushes them
 * into the memory cache.
 *
 * If the cache is full, the generated sample is dropped and
 * a warning is logged.
 *
 * @param timer Pointer to the kernel timer that triggered the callback.
 */
static void sample_timer_handler(struct k_timer *timer)
{
    sensor_sample_t sample;

    /* Generate IMU data */
    for (int i = 0; i < IMU_SAMPLE_LEN; i++) {
        /* Using rand() since sys_rand32_get is not supported by my board */
        sample.imu[i] = rand();
    }

    /* Generate float16 temperature samples */
    for (int i = 0; i < TEMP_SAMPLE_LEN; i++) {
        uint16_t raw = rand();
        sample.temp[i] = uint16_to_double(raw);
    }

    if (!mem_cache_push(&sample)) {
        LOG_WRN("Sample cache full, dropping sample");
    }
}

/**
 * @brief Initialize mock sensor module.
 *
 * This function initializes and starts a periodic kernel timer
 * used to generate mock sensor samples.
 *
 * It is automatically executed during the application initialization
 * phase.
 *
 * @return 0 on successful initialization.
 */
static int sensor_mock_init(void)
{
    srand(k_cycle_get_32());
    k_timer_init(&sample_timer, sample_timer_handler, NULL);
    k_timer_start(&sample_timer,
                  K_SECONDS(CONFIG_SAMPLE_INTERVAL_SEC),
                  K_SECONDS(CONFIG_SAMPLE_INTERVAL_SEC));

    LOG_INF("Sensor mock initialized");
    return 0;
}

SYS_INIT(sensor_mock_init, APPLICATION, CONFIG_APPLICATION_INIT_PRIORITY);
```
